## conf/layer.conf
```bitbake
# We have a conf and classes directory, add to BBPATH
BBPATH .= ":${LAYERDIR}"

# We have recipes-* directories, add to BBFILES
BBFILES += "${LAYERDIR}/recipes-*/*/*.bb ${LAYERDIR}/recipes-*/*/*.bbappend"

BBFILE_COLLECTIONS += "a38"
BBFILE_PATTERN_a38 = "^${LAYERDIR}/"
BBFILE_PRIORITY_a38 = "11"

# This should only be incremented on significant changes that will
# cause compatibility issues with other layers
LAYERVERSION_a38 = "1"

LAYERDEPENDS_a38 = "core"

LAYERSERIES_COMPAT_a38 = "dunfell"
```
